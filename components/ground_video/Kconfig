## components/ground_video/Kconfig
```kconfig
menu "Ground video recovery"

config VSTREAMER_RS_PIE
    bool "Use ESP32-P4 PIE SIMD for Reed-Solomon recovery"
    depends on SOC_CPU_HAS_PIE
    default y
    help
        Compile the pinned vstreamer PIE GF matrix kernel for missing-data
        reconstruction. Startup compares it with the scalar reference using
        unaligned inputs and odd lengths; mismatches disable PIE at runtime.

config VSTREAMER_RX_PSRAM
    bool "Allocate FEC padding and recovered rows in PSRAM"
    depends on SPIRAM
    default y

endmenu
```

## tools/c6-uart-bridge/main/Kconfig.projbuild
```kconfig
menu "C6 UART bridge"

choice C6_BRIDGE_BOARD
    prompt "Board"
    default C6_BRIDGE_BOARD_GUITION
    help
        Guition uses P4 GPIO32 TX / GPIO33 RX and GPIO45 for C6 BOOT.
        Waveshare uses P4 GPIO46 TX / GPIO48 RX and GPIO47 for C6 BOOT.
        Both boards connect C6 CHIP_PU to P4 GPIO54 and need LDO_VO4
        at 3.3 V for the boot strap's IO domain.

config C6_BRIDGE_BOARD_GUITION
    bool "Guition JC-ESP32P4-M3-DEV (boot strap GPIO45, LDO_VO4)"

config C6_BRIDGE_BOARD_WAVESHARE
    bool "Waveshare ESP32-P4-WIFI6-DEV-KIT (TX46/RX48, boot GPIO47, LDO_VO4)"

endchoice

endmenu
```
